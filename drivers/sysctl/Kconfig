## drivers/sysctl/Kconfig
```kconfig
# PWM configuration options

# Copyright (c) 2015 Intel Corporation
# SPDX-License-Identifier: Apache-2.0

menuconfig SYSCTL
	bool "SYSCTL Drivers"
	default n
	help
	  Enable config options for SYSCTL drivers.

if SYSCTL

module = SYSCTL
module-str = sysctl
source "subsys/logging/Kconfig.template.log_config"

source "drivers/sysctl/Kconfig.nrfx"
#temp
choice
        prompt "RPMSG device role"
        default RPMSG_REMOTE

config IPM_NRFX_IPC
        bool "IPMNRFX"

config TASKS_SEND_0_IPC_CHANNEL_0
        bool "ts0ic0"

config EVENTS_RECEIVE_0_IPC_CHANNEL_1
        bool "er0ic1"

config TASKS_SEND_0_IPC_CHANNEL_1
        bool "ts0ic1"

config EVENTS_RECEIVE_0_IPC_CHANNEL_0
        bool "er0ic0"

config CALLBACK_ON_EVENT_RECEIVE_0
        bool "coer0"

config RPMSG_REMOTE
        bool "Remote"

config RPMSG_MASTER
        bool "Master"

endchoice


endif # SYSCTL
```

## drivers/sysctl/Kconfig.nrfx
```kconfig
# System controller driver configuration options

# Copyright (c) 2020 Nordic Semiconductor ASA
# SPDX-License-Identifier: Apache-2.0


menuconfig NRF_SYSCTL
	bool "nRF system controller enable"
	default y
	depends on SOC_FAMILY_NRF
	help
	  Enable System Controller feature.

if NRF_SYSCTL

choice
        prompt "Device type"
        default NRF_SYSCTL_LOCAL_DOMAIN

config NRF_SYSCTL_LOCAL_DOMAIN
        bool "Local Domain"

config NRF_SYSCTL_SYSTEM_CONTROLLER
        bool "System Controller"

endchoice

config NRF_MSG_DATA_SIZE
	int "Data field size"
	default 64

endif # NRF_SYSCTL
```

## dts/bindings/comparator/nordic,nrf-comparator.yaml
```yaml
# Copyright (c) 2019 Nordic Semiconductor ASA
# SPDX-License-Identifier: Apache-2.0

title: Nordic comparator

description: >
    Binding for the Nordic comparator module

compatible: "nordic,nrf-comparator"

include: base.yaml

properties:
    reg:
      required: true

    interrupts:
      required: true

    ain0-pin:
      type: int
      required: false
      description: analog input 0

    ain1-pin:
      type: int 
      required: false
      description: analog input 1

    ain2-pin:
      type: int 
      required: false
      description: analog input 2

    ain3-pin:
      type: int 
      required: false
      description: analog input 3

    ain4-pin:
      type: int 
      required: false
      description: analog input 4

    ain5-pin:
      type: int 
      required: false
      description: analog input 5

    ain6-pin:
      type: int 
      required: false
      description: analog input 6

    ain7-pin:
      type: int 
      required: false
      description: analog input 7
```

## dts/bindings/i2s/nordic,nrf-i2s.yaml
```yaml
title: Nordic I2S

description: >
    This binding gives a base representation of the Nordic I2S

compatible: "nordic,nrf-i2s"

include:  i2s-controller.yaml

properties:
    reg:
      required: true

    interrupts:
      required: true

    sck-pin:
      type: int
      required: true
      description: SCK pin

    lrck-pin:
      type: int
      required: true
      description: LRCK pin

    sdout-pin:
      type: int
      required: false
      description: SDOUT pin

    sdin-pin:
      type: int
      required: false
      description: SDIN pin

    mck-pin:
      type: int
      required: false
      description: MCK pin
```

## dts/bindings/i2s/nordic,nrfx-i2s.yaml
```yaml
title: Nordic I2S

description: >
    This binding gives a base representation of the Nordic I2S

compatible: "nordic,nrf-i2s"

include:  i2s-controller.yaml

properties:
    reg:
      required: true

    interrupts:
      required: true
```
